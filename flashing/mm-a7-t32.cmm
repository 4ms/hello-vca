; Load a multi-uimg file to DDR RAM, and then trigger MP1-Boot to process it
; This assumes this script is in flashing/, and the uimg file is build/main.uimg
; and the elf file (used for symbols) is build/mp1corea7/medium/main.elf
MENU.Reprogram
(
ADD
  MENU
  (
    POPUP "Custom"
    (
      MENUITEM "ProgListen,F10" "Run ~/4ms/stm32/listenclosely/flashing/mm-a7-t32.cmm"
    )
  )
)

PRIVATE &builddir
&builddir=OS.PPF()
&builddir=OS.FILE.PATH("&builddir")

PRIVATE &binfile
&binfile=OS.FILE.JOINPATH("&builddir", "../", "build", "main.bin")
&binfile=OS.FILE.REALPATH("&binfile")

PRIVATE &elffile
&elffile=OS.FILE.JOINPATH("&builddir", "../", "build", "src", "main.elf")
&elffile=OS.FILE.REALPATH("&elffile")

RESet
SYStem.RESet

SYStem.CPU STM32MP135D
SYStem.JtagClock 50MHz

Trace.DISable
SYStem.MemAccess DAP
SYStem.Up

Data.LOAD.Binary "&binfile" 0x2FFE7040 /DUALPORT
Data.LOAD.Elf "&elffile" /CPP /NoCode
PER.Set.simple AZSD:0x0:0x5C00A118 %Long 0x2FFE7040
//Break 0x2FFE7040
Go

Trace.METHOD ONCHIP
ETM.Trace ON
ETM.ON

Trace.arm
ENDDO
