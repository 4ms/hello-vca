; Load a multi-uimg file to DDR RAM, and then trigger MP1-Boot to process it


PRIVATE &builddir
&builddir=OS.PPF()
&builddir=OS.FILE.PATH("&builddir")

PRIVATE &binfile
&binfile=OS.FILE.JOINPATH("&builddir", "../", "build", "main.uimg")
&binfile=OS.FILE.REALPATH("&binfile")

PRIVATE &elffile
&elffile=OS.FILE.JOINPATH("&builddir", "../", "build", "src", "main.elf")
&elffile=OS.FILE.REALPATH("&elffile")

RESet
SYStem.RESet

SYStem.CPU STM32MP153D-CA7
SYStem.JtagClock 50MHz

Trace.DISable
SYStem.MemAccess DAP
SYStem.Up

Data.LOAD.Binary "&binfile" 0xC0000000 /DUALPORT
Data.LOAD.Elf "&elffile" /CPP /NoCode
PER.Set.simple AZSD:0x0:0x5C00A118 %Long 0xC0000000
//Break 0x2FFE7040
Go

Trace.METHOD ONCHIP
ETM.Trace ON
ETM.ON

Trace.arm
ENDDO
